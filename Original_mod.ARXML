AUTOSAR XML
3 x :
  ContainerA  # AA
  ContainerB  # BB
  ContainerC  # CC
